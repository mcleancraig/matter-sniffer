## firmware/main/Kconfig.projbuild
```kconfig
menu "Matter Sniffer Configuration"

    config MATTER_SNIFFER_WIFI_SSID
        string "WiFi SSID"
        default ""
        help
            WiFi network to connect to. Can also be set via serial command or web UI.

    config MATTER_SNIFFER_WIFI_PASSWORD
        string "WiFi Password"
        default ""
        help
            WiFi password. Can also be set via serial command or web UI.

    config MATTER_SNIFFER_MQTT_HOST
        string "MQTT Broker Host"
        default ""
        help
            Home Assistant MQTT broker IP address or hostname.

    config MATTER_SNIFFER_MQTT_PORT
        int "MQTT Broker Port"
        default 1883
        help
            MQTT broker port.

    config MATTER_SNIFFER_MQTT_USER
        string "MQTT Username"
        default ""
        help
            MQTT broker username (optional).

    config MATTER_SNIFFER_MQTT_PASS
        string "MQTT Password"
        default ""
        help
            MQTT broker password (optional).

    config MATTER_SNIFFER_PCAP_ENABLED
        bool "Enable pcap output on startup"
        default n
        help
            If enabled, pcap frames are streamed over USB serial from boot.
            Can be toggled at runtime via serial command.

endmenu
```

## firmware/sdkconfig.defaults
```kconfig
# Target
CONFIG_IDF_TARGET="esp32s3"

# Flash — ESP32-S3 DevKits typically ship with 4MB or 8MB
CONFIG_ESPTOOLPY_FLASHSIZE_8MB=y
CONFIG_ESPTOOLPY_FLASHSIZE="8MB"

# System
CONFIG_ESP_MAIN_TASK_STACK_SIZE=8192
CONFIG_FREERTOS_HZ=1000

# WiFi
CONFIG_ESP_WIFI_STATIC_RX_BUFFER_NUM=16
CONFIG_ESP_WIFI_DYNAMIC_RX_BUFFER_NUM=64
CONFIG_ESP_WIFI_TX_BUFFER=DYNAMIC
CONFIG_ESP_WIFI_STATIC_TX_BUFFER_NUM=16

# lwIP
CONFIG_LWIP_LOCAL_HOSTNAME="matter-sniffer"
CONFIG_LWIP_IPV6=y
CONFIG_LWIP_IGMP=y
CONFIG_LWIP_SO_RCVBUF=y

# MQTT
CONFIG_MQTT_PROTOCOL_311=y

# HTTP server
CONFIG_HTTPD_WS_SUPPORT=y

# Logging
CONFIG_LOG_DEFAULT_LEVEL_INFO=y
CONFIG_LOG_MAXIMUM_LEVEL_DEBUG=y

# Partition table
CONFIG_PARTITION_TABLE_CUSTOM=y
CONFIG_PARTITION_TABLE_CUSTOM_FILENAME="partitions.csv"

# USB CDC (for serial over USB on ESP32-S3)
CONFIG_ESP_CONSOLE_USB_SERIAL_JTAG=y

# PSRAM (if available on your DevKit)
CONFIG_SPIRAM=y
CONFIG_SPIRAM_MODE_OCT=y
CONFIG_SPIRAM_SPEED_80M=y
CONFIG_SPIRAM_USE_MALLOC=y
```
